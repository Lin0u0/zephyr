## boards/astrathreshold/astralauncher/Kconfig.defconfig
```kconfig
# Copyright (c) 2020 Brian Bradley
# SPDX-License-Identifier: Apache-2.0

# F411CE based Astra Launcher board board configuration

if BOARD_ASTRALAUNCHER_F411CE

config SPI_STM32_INTERRUPT
	default y
	depends on SPI

endif # BOARD_ASTRALAUNCHER_F411CE
```

## boards/astrathreshold/astralauncher/board.yml
```yaml
board:
  name: astralauncher_f411ce
  full_name: Astra Launcher 32F4
  vendor: weact
  socs:
    - name: stm32f411xe
```
